VERSION "HIPBNYYYYYYYYYYYYYYYYYYYYYYYYYYYYYYYYYYYYY/4/%%%/4/'%**4YYY///"

NS_ :

BS_:

BU_:

BO_ 1302 accelerator_report: 8 Vector__XXX
 SG_ acc_pedal_fdbk : 0|16@1+ (1,0) [0|0] "" Vector__XXX
 SG_ acc_pedal_fdbk_counter : 16|8@1+ (1,0) [0|0] "" Vector__XXX
